## Kconfig
```kconfig
#
# Copyright (c) 2022 Laird Connectivity LLC
#
# SPDX-License-Identifier: LicenseRef-LairdConnectivity-Clause
#
menuconfig LCZ_PKI_AUTH
	bool "LCZ PKI Authentication"
	depends on ATTR
	depends on FILE_SYSTEM_UTILITIES
	depends on MBEDTLS
	select MBEDTLS_PK_WRITE_C
	select MBEDTLS_X509_CREATE_C
	select MBEDTLS_X509_CSR_WRITE_C
	help
	  The PKI authentication module provides services to allow the device to
	  authenticate itself with other devices/services and to verify the
	  authenticity of other devices/services that it communicates with. If
	  credentials are loaded into the TLS credential storage, the key and
	  certificates will be stored in malloc-ed memory, so sufficient heap
	  space must be present to store the credentials.

if LCZ_PKI_AUTH

module=LCZ_PKI_AUTH
module-str=LCZ_PKI_AUTH
source "subsys/logging/Kconfig.template.log_config"

config LCZ_PKI_AUTH_SHELL
	bool "PKI authentication shell commands"
	depends on SHELL
	default y if SHELL

config LCZ_PKI_AUTH_SMP_PERIPHERAL
	bool "PKI Authentication over SMP peripheral"
	depends on MCUMGR
	help
	  The "peripheral" implementation of PKI authentication. This should be
	  available over BLE and/or shell/UART.

config LCZ_PKI_AUTH_SMP_CENTRAL
	bool "PKI Authentication over SMP central"
	depends on LCZ_LWM2M_GATEWAY_OBJ
	depends on LCZ_BT
	depends on BT_CENTRAL
	depends on BT_DFU_SMP
	help
	  The "central" implementation of PKI authentication. Talks to the "peripheral"
	  implementation to allow the devices to authenticate each other.

config LCZ_PKI_AUTH_SMP_GROUP_ID
	int "SMP group ID for PKI authentication"
	default 70

config LCZ_PKI_AUTH_SMP_SESSION_TIME
	int "Length of an SMP authentication session in seconds"
	default 86400
	help
	  This time is the period that session resume messages will be used instead of
	  the full certificate exchange between sensors and gateways.

config LCZ_PKI_AUTH_SMP_INIT_PRIORITY
	int "Application initialization priority for PKI auth SMP"
	default APPLICATION_INIT_PRIORITY

endif # LCZ_PKI_AUTH
```
